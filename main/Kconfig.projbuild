## main/Kconfig.projbuild
```kconfig
menu "ILF OS"

config ILF_YANDEX_CLIENT_ID
    string "Яндекс OAuth: ClientID приложения"
    default ""
    help
        Приложение регистрируется на oauth.yandex.ru с правами
        «Доступ к папке приложения на Диске» (cloud_api:disk.app_folder).
        Пусто — выгрузка на Диск выключена.

config ILF_YANDEX_CLIENT_SECRET
    string "Яндекс OAuth: Client secret"
    default ""

endmenu
```

## sdkconfig.defaults
```kconfig
CONFIG_IDF_TARGET="esp32s3"
CONFIG_ESPTOOLPY_FLASHMODE_QIO=y
CONFIG_ESPTOOLPY_FLASHSIZE_16MB=y
CONFIG_PARTITION_TABLE_CUSTOM=y
CONFIG_PARTITION_TABLE_CUSTOM_FILENAME="partitions.csv"
CONFIG_SPIRAM=y
CONFIG_SPIRAM_MODE_OCT=y
CONFIG_SPIRAM_SPEED_80M=y
CONFIG_ESP_DEFAULT_CPU_FREQ_MHZ_240=y
CONFIG_ESP32S3_DATA_CACHE_LINE_64B=y
CONFIG_FREERTOS_HZ=1000
CONFIG_ESP_MAIN_TASK_STACK_SIZE=4096
CONFIG_ESP_CONSOLE_USB_SERIAL_JTAG=y

# LVGL
CONFIG_LV_COLOR_DEPTH_16=y
CONFIG_LV_USE_CLIB_MALLOC=y
CONFIG_LV_USE_CLIB_STRING=y
CONFIG_LV_USE_CLIB_SPRINTF=y
CONFIG_LV_FONT_MONTSERRAT_14=y
CONFIG_LV_FONT_MONTSERRAT_32=y
CONFIG_LV_DEF_REFR_PERIOD=33
CONFIG_LV_USE_LOG=y
CONFIG_LV_LOG_LEVEL_WARN=y
CONFIG_LV_LOG_PRINTF=y
CONFIG_LV_BUILD_EXAMPLES=n

# Стадо (ESP-NOW): ключ шифрования на каждого друга
CONFIG_ESP_WIFI_ESPNOW_MAX_ENCRYPT_NUM=12
CONFIG_MBEDTLS_ECP_DP_CURVE25519_ENABLED=y
CONFIG_SPIRAM_USE_MALLOC=y

# Экономия батареи: частота по нагрузке, лёгкий сон, сон радио без подключения
CONFIG_PM_ENABLE=y
CONFIG_FREERTOS_USE_TICKLESS_IDLE=y
CONFIG_ESP_WIFI_STA_DISCONNECTED_PM_ENABLE=y

# Bluetooth LE с iPhone (NimBLE): время, музыка, уведомления
CONFIG_BT_ENABLED=y
CONFIG_BT_NIMBLE_ENABLED=y
CONFIG_BT_NIMBLE_ROLE_CENTRAL=n
CONFIG_BT_NIMBLE_ROLE_OBSERVER=n
CONFIG_BT_NIMBLE_MAX_CONNECTIONS=1
CONFIG_BT_NIMBLE_MAX_BONDS=3
CONFIG_BT_NIMBLE_NVS_PERSIST=y
CONFIG_BT_NIMBLE_SM_SC=y
CONFIG_BT_NIMBLE_LOG_LEVEL_WARNING=y
CONFIG_ESP_COEX_SW_COEXIST_ENABLE=y
# BLE спит вместе с чипом (без внешнего кварца 32 кГц)
CONFIG_BT_CTRL_MODEM_SLEEP=y
CONFIG_BT_CTRL_MODEM_SLEEP_MODE_1=y
CONFIG_BT_CTRL_LPCLK_SEL_MAIN_XTAL=y
CONFIG_BT_CTRL_MAIN_XTAL_PU_DURING_LIGHT_SLEEP=y
```
